## zephyr/boards/Kconfig.defconfig
```kconfig
if BOARD_PLYTA

config SERIAL
    default y

config UART_NS16550
    default y

config CONSOLE
    default y

config UART_CONSOLE
    default y

config TICKLESS_KERNEL
    default y
config UART_INTERRUPT_DRIVEN
    default y

config UART_NS16550_ACCESS_WORD_ONLY
    default y
# config PLIC
#     default y

config RISCV_SOC_INTERRUPT_INIT
    default y

config 2ND_LVL_ISR_TBL_OFFSET
	default 12

config 2ND_LVL_INTR_00_OFFSET
	default 11

config 2ND_LEVEL_INTERRUPT_BITS
	default 11
config MULTI_LEVEL_INTERRUPTS
	default y
endif # BOARD_PLYTA
```

## zephyr/boards/board.yml
```yaml
board:
  name: plyta
  full_name: RV32IM Kria Softcore
  vendor: luki
  socs:
  - name: skieta
```

## zephyr/boards/luki/plyta/Kconfig.defconfig
```kconfig
if BOARD_PLYTA

config SERIAL
    default y

config UART_NS16550
    default y

config CONSOLE
    default y

config UART_CONSOLE
    default y

config TICKLESS_KERNEL
    default y
config UART_INTERRUPT_DRIVEN
    default y



endif # BOARD_PLYTA
```

## zephyr/soc/Kconfig
```kconfig
config SOC_SKIETA
	select RISCV
	select RISCV_ISA_RV32I
	select RISCV_ISA_BASE_FENCE
	select RISCV_ISA_EXT_M
	select RISCV_ISA_EXT_A
	select RISCV_ISA_EXT_ZICSR
	select RISCV_ISA_EXT_ZICNTR
	select RISCV_MACHINE_TIMER
	select RISCV_PRIVILEGED
	select RISCV_HAS_PLIC
	select INCLUDE_RESET_VECTOR

if SOC_SKIETA

endif
```

## zephyr/soc/Kconfig.defconfig
```kconfig
if SOC_SKIETA
	config SYS_CLOCK_HW_CYCLES_PER_SEC
		default $(dt_node_int_prop_int,/cpus/cpu@0,clock-frequency)
	config NUM_IRQS
		default 48
	config MAX_IRQ_PER_AGGREGATOR
		default 32
endif
```

## zephyr/soc/luki/skieta/Kconfig
```kconfig
config SOC_SKIETA
	select RISCV
	select RISCV_ISA_RV32I
	select RISCV_ISA_BASE_FENCE
	select RISCV_ISA_EXT_M
	select RISCV_ISA_EXT_ZICSR
	select RISCV_ISA_EXT_ZICNTR
	select RISCV_MACHINE_TIMER
	select RISCV_PRIVILEGED

if SOC_SKIETA

endif
```

## zephyr/soc/luki/skieta/Kconfig.soc
```kconfig
config SOC_SKIETA
	bool
	help
	  Some core of mine
config SOC
	default "skieta" if SOC_SKIETA
```
